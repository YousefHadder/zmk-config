## config/west.yml
```yaml
manifest:
  remotes:
    - name: zmkfirmware
      url-base: https://github.com/zmkfirmware
    - name: yousefhadder                         #new entry
      url-base: https://github.com/yousefhadder
  projects:
    - name: zmk
      remote: zmkfirmware
      revision: main
      import: app/west.yml
    - name: nice-view-mod          #new entry
      remote: yousefhadder        #new entry
      revision: main                      #new entry
  self:
    path: config
```
